## Kconfig
```kconfig
module = LBM
module-str = LoRa Basics Modem
source "subsys/logging/Kconfig.template.log_config"
```

## lbm_v4_sidewalk/Kconfig
```kconfig
config LBM_REBOOT_ON_PANIC
    bool "reset MCU on LBM panic"
	default n
	help
		reset upon panic, or no for halt
		
```

## lib/Kconfig
```kconfig
# Copyright (c) 2021 Legrand North America, LLC.
# SPDX-License-Identifier: Apache-2.0

config RADIO_TIMING_TEST
	bool "enable radio timing test"
    select UART_ASYNC_API
	default n
	help
		puts onto arduino uart some characters to identify execution points in the src

menu "Libraries"

endmenu
```

## samples/SWTL001/Kconfig
```kconfig
#
# Copyright (c) 2022 Nordic Semiconductor ASA
#
# SPDX-License-Identifier: LicenseRef-Nordic-5-Clause
#

mainmenu "Sidewalk End Device nRF Connect Application"

choice SID_END_DEVICE
	prompt "Select application variant to run"
    default SID_END_DEVICE_SWTL001
config SID_END_DEVICE_SWTL001
    bool "LR11xx firmware update application"
endchoice #SID_END_DEVICE

config SID_END_DEVICE_CLI
    bool "Enable Sidewalk CLI (DUT)"
    imply SHELL
    help
      Enables Sidewalk command line interface.
      The interface commands are compatilbe with former dut sample.

config SMTC_CLI
	bool "enable semtech CLI"
	imply SHELL
	help
		Enables semtech radio command line interface.

config SID_END_DEVICE_AUTO_START
    default y
    bool "Enable automatic Sidewalk initlization and start"

config SID_END_DEVICE_AUTO_CONN_REQ
    default y
    bool "Enable automatic connection request before message send"

config SID_END_DEVICE_PERSISTENT_LINK_MASK
    bool "Enable persitent link mask"
    help
      The Sidewalk link mask persists after a device reset
      but defaults after a factory reset.
      This could affect the flash lifespan.

config SID_END_DEVICE_EVENT_HEAP_SIZE
    int "Heap for Sidewalk event contexts"
    default 2048

rsource "Kconfig.defconfig"

source "Kconfig.zephyr"
```

## west.yml
```yaml
# Copyright (c) 2021 Nordic Semiconductor ASA
# SPDX-License-Identifier: Apache-2.0

manifest:
  self:
    west-commands: scripts/west-commands.yml

  remotes:
    - name: ncs
      url-base: https://github.com/nrfconnect
    - name: smtc
      url-base: https://gitlab.semtech.com/Apps-customers/sidewalk

  projects:
    - name: nrf
      remote: ncs
      repo-path: sdk-nrf
      revision: v2.6.1
      import: true
    - name: sidewalk
      remote: ncs
      repo-path: sdk-sidewalk
      revision: v2.6.1
    - name: lbm431
      remote: smtc
      repo-path: lr11xx-sidewalk-sdk-v2.5.0
      revision: lbm_v431
    - name: lbm450
      remote: smtc
      repo-path: lr11xx-sidewalk-sdk-v2.5.0
      revision: lbm_v450
```
